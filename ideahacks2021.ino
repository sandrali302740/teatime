/******************************************************
IdeaHacks 2021: Sandra and Vani
1/16/2021
Code sampled from randomnerdtutorials.com
*******************************************************/
#include <stdint.h>
#include <Wire.h>
#include <Adafruit_GFX.h>
#include <Adafruit_SSD1306.h>

#define SCREEN_WIDTH 128 // OLED display width, in pixels
#define SCREEN_HEIGHT 64 // OLED display height, in pixels

// Declaration for an SSD1306 display connected to I2C (SDA, SCL pins)
Adafruit_SSD1306 display(SCREEN_WIDTH, SCREEN_HEIGHT, &Wire, -1);

//insert image arrays
static const uint8_t image_data_cold01[1024] = {
    0x00, 0x00, 0x00, 0x00, 0x00, 0x00, 0x00, 0x00, 0x00, 0x00, 0x00, 0x00, 0x00, 0x00, 0x00, 0x00, 
    0x00, 0x00, 0x00, 0x00, 0x00, 0x00, 0x00, 0x00, 0x00, 0x00, 0x00, 0x00, 0x00, 0x00, 0x00, 0x00, 
    0x00, 0x00, 0x00, 0x00, 0x00, 0x00, 0x00, 0x00, 0x00, 0x00, 0x00, 0x00, 0x00, 0x00, 0x00, 0x00, 
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    0x00, 0x00, 0x00, 0x00, 0x00, 0x00, 0x00, 0x00, 0x00, 0x00, 0x00, 0x00, 0x00, 0x00, 0x00, 0x00
};

static const uint8_t image_data_cold02[1024] = {
    0xff, 0xff, 0xff, 0xff, 0xff, 0xff, 0xff, 0xff, 0xff, 0xff, 0xff, 0xff, 0xff, 0xff, 0xff, 0xff, 
    0xff, 0xff, 0xff, 0xff, 0xff, 0xff, 0xff, 0xff, 0xff, 0xff, 0xff, 0xff, 0xff, 0xff, 0xff, 0xff, 
    0xff, 0xff, 0xff, 0xff, 0xff, 0xff, 0xff, 0xff, 0xff, 0xff, 0xff, 0xff, 0xff, 0xff, 0xff, 0xff, 
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    0xff, 0xff, 0xff, 0xff, 0xff, 0xff, 0xff, 0xff, 0xff, 0xff, 0xff, 0xff, 0xff, 0xff, 0xff, 0xff
};

static const uint8_t image_data_fire[1024] = {
    0xff, 0xff, 0xff, 0xff, 0xff, 0xff, 0xff, 0xff, 0xff, 0xff, 0xff, 0xff, 0xff, 0xff, 0xff, 0xff, 
    0xff, 0xff, 0xff, 0xff, 0xff, 0xff, 0xff, 0xff, 0xff, 0xff, 0xff, 0xff, 0xff, 0xff, 0xff, 0xff, 
    0xff, 0xff, 0xff, 0xff, 0xff, 0xff, 0xff, 0xff, 0xff, 0xff, 0xff, 0xff, 0xff, 0xff, 0xff, 0xff, 
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    0xff, 0xff, 0xff, 0xff, 0xff, 0xff, 0xff, 0xff, 0xff, 0xff, 0xff, 0xff, 0xff, 0xff, 0xff, 0xff
};

static const uint8_t image_data_warm01[1024] = {
    0xff, 0xff, 0xff, 0xff, 0xff, 0xff, 0xff, 0xff, 0xff, 0xff, 0xff, 0xff, 0xff, 0xff, 0xff, 0xff, 
    0xff, 0xff, 0xff, 0xff, 0xff, 0xff, 0xff, 0xff, 0xff, 0xff, 0xff, 0xff, 0xff, 0xff, 0xff, 0xff, 
    0xff, 0xff, 0xff, 0xff, 0xff, 0xff, 0xff, 0xff, 0xff, 0xff, 0xff, 0xff, 0xff, 0xff, 0xff, 0xff, 
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    0xff, 0xff, 0xff, 0xff, 0xff, 0xff, 0xff, 0xff, 0xff, 0xff, 0xff, 0xff, 0xff, 0xff, 0xff, 0xff
};

static const uint8_t image_data_warm02[1024] = {
    0xff, 0xff, 0xff, 0xff, 0xff, 0xff, 0xff, 0xff, 0xff, 0xff, 0xff, 0xff, 0xff, 0xff, 0xff, 0xff, 
    0xff, 0xff, 0xff, 0xff, 0xff, 0xff, 0xff, 0xff, 0xff, 0xff, 0xff, 0xff, 0xff, 0xff, 0xff, 0xff, 
    0xff, 0xff, 0xff, 0xff, 0xff, 0xff, 0xff, 0xff, 0xff, 0xff, 0xff, 0xff, 0xff, 0xff, 0xff, 0xff, 
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    0xff, 0xff, 0xff, 0xff, 0xff, 0xff, 0xff, 0xff, 0xff, 0xff, 0xff, 0xff, 0xff, 0xff, 0xff, 0xff
};

const int buttonPin = 4;    // the number of the pushbutton pin
const int ledPin = 5;       // the number of the LED pin

int ledState = LOW;         // the current state of the output pin
int buttonState = LOW;             // the current reading from the input pin
int lastButtonState = LOW;   // the previous reading from the input pin
int start = LOW;                   // to trigger the start stuff

unsigned long lastDebounceTime = 0;  // the last time the output pin was toggled
unsigned long debounceDelay = 50;    // the debounce time; increase if the output flickers
unsigned long startTime = 0;         // the start time to be used as a baseline
unsigned long hotTime = 300000;         // while its hot
unsigned long coolTime = 30000;        // while it warm

void setup() {
  Serial.begin(115200);

  pinMode(buttonPin, INPUT);
  pinMode(ledPin, OUTPUT);

  // set initial LED state
  digitalWrite(ledPin, ledState);

  if(!display.begin(SSD1306_SWITCHCAPVCC, 0x3C)) { // I2C address
    Serial.println(F("SSD1306 allocation failed"));
    for(;;);
  }
  delay(2000);

  display.clearDisplay();
  display.setTextSize(2);
  display.setTextColor(WHITE); //doesn't work but you need it to be here??
  display.setCursor(0, 0);
  display.println("tea\ntime");
  display.display(); 
  delay(1000);
  /*
  display.drawBitmap(0, 0, image_data_fire, SCREEN_WIDTH, SCREEN_HEIGHT, 1);
  display.display();
  display.startscrollright(0x00, 0x0F);
  delay(2000);
  */
//  Serial.print("Loop entered.\n");
}

void loop() {
  // read the state of the switch into a local variable:
  int reading = digitalRead(buttonPin);
  //Serial.print(reading);

  // check to see if you just pressed the button
  // (i.e. the input went from LOW to HIGH), and you've waited long enough
  // since the last press to ignore any noise:

  // If the switch changed, due to noise or pressing:
  if (reading != lastButtonState) {
    // reset the debouncing timer
    lastDebounceTime = millis();
  }

  if ((millis() - lastDebounceTime) > debounceDelay) {
    // whatever the reading is at, it's been there for longer than the debounce
    // delay, so take it as the actual current state:

    // if the button state has changed:
    if (reading != buttonState) {
      buttonState = reading;

      // only toggle the LED if the new button state is HIGH
      if (buttonState == HIGH) {
        ledState = !ledState;
        start = !start;
      }
    }
  }

  // set the LED:
  digitalWrite(ledPin, ledState);

  // save the reading. Next time through the loop, it'll be the lastButtonState:
  lastButtonState = reading;


  if(start == HIGH){
    // start a timer
    startTime = millis();
    // write to the display with the stuff
    while((millis() - startTime) < hotTime){
        //the code for hot time
        display.clearDisplay();
        display.drawBitmap(0, 0, image_data_fire, SCREEN_WIDTH, SCREEN_HEIGHT, 1);
        display.display();
        display.startscrollright(0x00, 0x0F);
        delay(4000);
      }
     display.stopscroll();
    while((millis() - startTime) < (coolTime+hotTime)){
        // the code for lukewarm joy
        display.clearDisplay();
        display.drawBitmap(0, 0, image_data_warm01, SCREEN_WIDTH, SCREEN_HEIGHT, 1);
        display.display();
        delay(1000);
        display.clearDisplay();
        display.drawBitmap(0, 0, image_data_warm02, SCREEN_WIDTH, SCREEN_HEIGHT, 1);
        display.display();
        delay(1000);
      }
    while(((millis() - startTime) > (coolTime + hotTime)) && (millis() - startTime < (coolTime + hotTime)*1.5)){
        // flex the ice shawty
        display.clearDisplay();
        display.drawBitmap(0, 0, image_data_cold01, SCREEN_WIDTH, SCREEN_HEIGHT, 1);
        display.display();
        delay(1000);
        display.clearDisplay();
        display.drawBitmap(0, 0, image_data_cold02, SCREEN_WIDTH, SCREEN_HEIGHT, 1);
        display.display();
        delay(1000);
      }
     start = LOW;
     display.clearDisplay();
     display.setTextSize(2);
     display.setTextColor(WHITE); //doesn't work but you need it to be here??
     display.setCursor(0, 0);
     display.println("tea\ntime");
     display.display(); 
    } 
}
